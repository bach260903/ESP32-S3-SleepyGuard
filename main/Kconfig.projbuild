## main/Kconfig.projbuild
```kconfig
menu "Camera bring-up diagnostics"

config BRINGUP_FAULT_INJECTION
    bool "Compile controlled bring-up fault scenarios"
    default n
    help
        Bench-only fault injection for US2/US3 validation. Keep disabled in
        normal firmware builds.

choice BRINGUP_FAULT_SCENARIO
    prompt "Fault scenario"
    depends on BRINGUP_FAULT_INJECTION
    default BRINGUP_FAULT_SCENARIO_NONE

config BRINGUP_FAULT_SCENARIO_NONE
    bool "No fault"

config BRINGUP_FAULT_SCENARIO_PSRAM_UNAVAILABLE
    bool "Simulate unavailable PSRAM"

config BRINGUP_FAULT_SCENARIO_PSRAM_MISMATCH
    bool "Simulate PSRAM capacity mismatch"

config BRINGUP_FAULT_SCENARIO_PSRAM_ALLOCATE
    bool "Simulate PSRAM test allocation failure"

config BRINGUP_FAULT_SCENARIO_PSRAM_READBACK
    bool "Simulate PSRAM test readback mismatch"

config BRINGUP_FAULT_SCENARIO_CAMERA_INIT
    bool "Simulate every camera init attempt failing"

config BRINGUP_FAULT_SCENARIO_SINGLE_INVALID
    bool "One invalid frame after a real capture"

config BRINGUP_FAULT_SCENARIO_THREE_INVALID
    bool "Three consecutive invalid frames after real captures"

config BRINGUP_FAULT_SCENARIO_NO_FRAMES
    bool "Pause frame events after a valid frame"

config BRINGUP_FAULT_SCENARIO_WORKER_DELAY
    bool "Delay worker after returning a frame"

config BRINGUP_FAULT_SCENARIO_HOLD_FRAME
    bool "Hold a real frame before returning it"

config BRINGUP_FAULT_SCENARIO_RECOVERY_INIT
    bool "Fail selected recovery worker after real driver init"

config BRINGUP_FAULT_SCENARIO_INIT_NO_FRAME
    bool "Initialize driver then pause frame delivery"

endchoice

config BRINGUP_FAULT_WORKER_INDEX
    int "Apply fault to worker index (0 for every worker)"
    depends on BRINGUP_FAULT_INJECTION
    range 0 100
    default 1

config BRINGUP_FAULT_AFTER_FIRST_VALID_S
    int "Seconds after first valid frame before triggering fault"
    depends on BRINGUP_FAULT_INJECTION
    range 0 3600
    default 0

endmenu
```

## sdkconfig.defaults
```kconfig
CONFIG_ESPTOOLPY_FLASHSIZE_16MB=y
CONFIG_SPIRAM=y
CONFIG_SPIRAM_MODE_OCT=y
CONFIG_SPIRAM_SPEED_80M=y
CONFIG_SPIRAM_BOOT_INIT=y
CONFIG_SPIRAM_IGNORE_NOTFOUND=y
CONFIG_SPIRAM_USE_CAPS_ALLOC=y
# CONFIG_SPIRAM_MEMTEST is not set
CONFIG_ESP_DEFAULT_CPU_FREQ_MHZ_240=y
CONFIG_CAMERA_PSRAM_DMA=y
CONFIG_ESP_CONSOLE_UART_DEFAULT=y
CONFIG_ESP_CONSOLE_SECONDARY_NONE=y
# CONFIG_BRINGUP_FAULT_INJECTION is not set
```
